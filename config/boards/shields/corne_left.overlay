&i2c1 {
    status = "okay";
    ssd1306@3c {
        compatible = "solomon,ssd1306fb";
        reg = <0x3c>;
        label = "SSD1306";
        width = <128>;
        height = <64>;
        segment-offset = <0>;
        page-offset = <0>;
        display-offset = <0>;
        rotate = <180>;  // Change to 0 if your screen is mounted upright
        i2c-max-frequency = <400000>;
    };
};
